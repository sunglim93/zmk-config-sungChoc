## boards/shields/sungChoc/Kconfig.defconfig
```kconfig
if SHIELD_SUNGCHOC_LEFT

config ZMK_KEYBOARD_NAME
    default "Sung Choc"

config ZMK_SPLIT_ROLE_CENTRAL
    default y

endif # SHIELD_SUNGCHOC_LEFT

if SHIELD_SUNGCHOC_LEFT || SHIELD_SUNGCHOC_RIGHT

config ZMK_SPLIT
    default y

endif # SHIELD_SUNGCHOC_LEFT || SHIELD_SUNGCHOC_RIGHT
```

## boards/shields/sungChoc/Kconfig.shield
```kconfig
config SHIELD_SUNGCHOC_LEFT
    def_bool $(shields_list_contains,sungChoc_left)

config SHIELD_SUNGCHOC_RIGHT
    def_bool $(shields_list_contains,sungChoc_right)
```
