#include <dt-bindings/zmk/matrix_transform.h>

/ {
    chosen {
        zmk,kscan = &kscan_dummy;
        zmk,matrix-transform = &dummy_transform;
        zmk,split-role = "dongle";
    };

    kscan_dummy: kscan {
        compatible = "zmk,kscan-gpio-matrix";
        diode-direction = "col2row";
        row-gpios = <&gpio0 0 GPIO_ACTIVE_HIGH>;
        col-gpios = <&gpio0 1 GPIO_ACTIVE_HIGH>;
    };

    dummy_transform: keymap_transform_0 {
        compatible = "zmk,matrix-transform";
        columns = <1>;
        rows = <1>;
        map = <RC(0,0)>;
    };
};